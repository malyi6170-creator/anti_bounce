#include <avr/io.h>
#include <util/delay.h>

#define LED_PIN    PB0  // Светодиод (ножка 5)
#define BUTTON_PIN PB1  // Кнопка (ножка 6)

int main(void) {
    // Настройка портов
    DDRB |= (1 << LED_PIN);     // PB0 на выход
    DDRB &= ~(1 << BUTTON_PIN); // PB1 на вход
    PORTB |= (1 << BUTTON_PIN); // Включаем внутреннюю подтяжку PULL-UP

    uint8_t history = 0xFF;     // История состояний (по умолчанию 1 — кнопка отжата)
    uint8_t button_pressed = 0; // Флаг зафиксированного нажатия

    while (1) {
        // 1. Сдвигаем историю влево и записываем текущее состояние пина в младший бит
        // (1 — кнопка отжата, 0 — занулена на GND)
        history = (history << 1) | ((PINB >> BUTTON_PIN) & 0x01);

        // 2. Если 8 считываний подряд дали 0 (0x00) — кнопка гарантированно нажата
        if (history == 0x00) {
            if (!button_pressed) {
                PORTB ^= (1 << LED_PIN); // Тогглим светодиод по одиночному клику
                button_pressed = 1;      // Взводим флаг, чтобы не переключать по удерживанию
            }
        } 
        // 3. Если 8 считываний подряд дали 1 (0xFF) — кнопка гарантированно отпущена
        else if (history == 0xFF) {
            button_pressed = 0;          // Сбрасываем флаг, готовы к следующему клику
        }

        // КРИТИЧЕСКИ ВАЖНО:
        // Пауза 2 мс * 8 бит = окно фильтрации 16 мс.
        // Без этой задержки 8 бит забиваются за несколько микросекунд!
        _delay_ms(2); 
    }

    return 0;
}
